## package/libmpix/Config.in
```kconfig
config BR2_PACKAGE_LIBMPIX
	bool "libmpix"
	help
	  Library for Microcontroller Pixel processing.

	  libmpix is a C library designed for efficient pixel processing
	  on microcontrollers. It provides optimized functions for image
	  manipulation, format conversion, and pixel operations suitable
	  for embedded systems with limited resources.

	  Features:
	  - JPEG encoding support
	  - Media conversion utilities
	  - Optimized for microcontroller environments
	  - Low-level API for maximum flexibility

	  https://github.com/libmpix/libmpix
```

## package/luckfox-pico-rtsp-opencv/Config.in
```kconfig
config BR2_PACKAGE_LUCKFOX_PICO_RTSP_OPENCV
	bool "luckfox-pico-rtsp-opencv"
	depends on BR2_PACKAGE_OPENCV4
	depends on BR2_PACKAGE_OPENCV4_LIB_HIGHGUI
	depends on BR2_PACKAGE_OPENCV4_WITH_RK
	help
	  Build RTSP OpenCV example for Luckfox Pico.

comment "luckfox-pico-rtsp-opencv needs OpenCV4 with RK support and specific libraries"
	depends on !BR2_PACKAGE_OPENCV4 || !BR2_PACKAGE_OPENCV4_LIB_HIGHGUI || !BR2_PACKAGE_OPENCV4_WITH_RK

if BR2_PACKAGE_LUCKFOX_PICO_RTSP_OPENCV

config BR2_PACKAGE_LUCKFOX_PICO_RTSP_OPENCV_WIDTH
	int "Video width"
	default 1920
	help
	  Width of the video capture in pixels.

config BR2_PACKAGE_LUCKFOX_PICO_RTSP_OPENCV_HEIGHT
	int "Video height"
	default 1080
	help
	  Height of the video capture in pixels.

endif
```

## package/rv1106-rgbir-rtsp/Config.in
```kconfig
config BR2_PACKAGE_RV1106_RGBIR_RTSP
	bool "rv1106-rgbir-rtsp"
	select BR2_PACKAGE_LIBMPIX
	depends on BR2_PACKAGE_OPENCV4
	depends on BR2_PACKAGE_OPENCV4_LIB_HIGHGUI
	depends on BR2_PACKAGE_OPENCV4_WITH_RK
	depends on BR2_PACKAGE_RV1106_IPC_SDK
	help
	  Build RGB-IR RTSP streaming application for RV1106.
	  This package provides RTSP streaming capabilities for RGB-IR cameras
	  on the RV1106 platform.
```

## package/rv1106-smartir-rtsp/Config.in
```kconfig
config BR2_PACKAGE_RV1106_SMARTIR_RTSP
	bool "rv1106-smartir-rtsp"
	depends on BR2_PACKAGE_RV1106_IPC_SDK
	help
	  Build SmartIR RTSP streaming application for RV1106.
	  This package provides RTSP streaming capabilities with SmartIR
	  on the RV1106 platform.

if BR2_PACKAGE_RV1106_SMARTIR_RTSP

config BR2_PACKAGE_RV1106_SMARTIR_RTSP_WIDTH
	int "Video width"
	default 1920
	help
	  Width of the video capture in pixels.

config BR2_PACKAGE_RV1106_SMARTIR_RTSP_HEIGHT
	int "Video height"
	default 1080
	help
	  Height of the video capture in pixels.

endif
```
