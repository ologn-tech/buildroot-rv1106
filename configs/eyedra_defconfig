## configs/eyedra_defconfig
```kconfig
# Architecture
BR2_arm=y
BR2_cortex_a7=y

# Toolchain
BR2_TOOLCHAIN_EXTERNAL=y
BR2_TOOLCHAIN_EXTERNAL_ROCKCHIP_ARM=y

# System configuration
BR2_OPTIMIZE_3=y
BR2_TARGET_GENERIC_HOSTNAME="eyedra"
BR2_TARGET_GENERIC_ISSUE="Welcome to Eyedra"

# Kernel
BR2_LINUX_KERNEL=y
BR2_LINUX_KERNEL_CUSTOM_GIT=y
BR2_LINUX_KERNEL_CUSTOM_REPO_URL="https://github.com/ologn-tech/linux-rv1106.git"
BR2_LINUX_KERNEL_CUSTOM_REPO_VERSION="a32c6b1328d3fad4f39e6eaf32f24afcd2ad3372"
BR2_LINUX_KERNEL_DTS_SUPPORT=y
BR2_LINUX_KERNEL_CUSTOM_CONFIG_FILE="board/eyedra/linux.config"
BR2_LINUX_KERNEL_CUSTOM_DTS_PATH="board/eyedra/rv1106g3-eyedra.dts"
BR2_LINUX_KERNEL_IMAGE_NAME="boot.img"
BR2_LINUX_KERNEL_IMAGE_TARGET_CUSTOM=y
BR2_LINUX_KERNEL_IMAGE_TARGET_NAME="zImage"
BR2_LINUX_KERNEL_USE_CUSTOM_CONFIG=y

# Bootloader
BR2_PACKAGE_HOST_UBOOT_TOOLS=y
BR2_PACKAGE_HOST_UBOOT_TOOLS_ENVIMAGE=y
BR2_PACKAGE_HOST_UBOOT_TOOLS_ENVIMAGE_SOURCE="board/eyedra/uboot-env.txt"
BR2_PACKAGE_HOST_UBOOT_TOOLS_ENVIMAGE_SIZE="0x40000"
BR2_PACKAGE_HOST_UBOOT_TOOLS_FIT_SUPPORT=y
BR2_PACKAGE_HOST_UBOOT_TOOLS_FIT_SIGNATURE_SUPPORT=y
BR2_PACKAGE_ROCKCHIP_RKBIN=y
BR2_TARGET_UBOOT=y
BR2_TARGET_UBOOT_BOARD_DEFCONFIG="rv1106"
BR2_TARGET_UBOOT_BUILD_SYSTEM_KCONFIG=y
BR2_TARGET_UBOOT_CUSTOM_GIT=y
BR2_TARGET_UBOOT_CUSTOM_REPO_URL="https://github.com/ologn-tech/u-boot-rv1106.git"
BR2_TARGET_UBOOT_CUSTOM_REPO_VERSION="69481a4bc46f4e63f3f77d3326b4ccaf6a550551"
# BR2_TARGET_UBOOT_FORMAT_BIN is not set
BR2_TARGET_UBOOT_FORMAT_CUSTOM=y
BR2_TARGET_UBOOT_FORMAT_CUSTOM_NAME="uboot.img"

# Filesystem
BR2_ROOTFS_POST_BUILD_SCRIPT="board/eyedra/post-build.sh"
BR2_ROOTFS_POST_IMAGE_SCRIPT="board/eyedra/post-image.sh"
# BR2_TARGET_ROOTFS_TAR is not set
BR2_TARGET_ROOTFS_UBI=y
BR2_TARGET_ROOTFS_UBI_SUBSIZE=0
BR2_TARGET_ROOTFS_UBIFS_LEBSIZE=0x1f000
BR2_TARGET_ROOTFS_UBIFS_MAXLEBCNT=2047
BR2_TARGET_ROOTFS_UBIFS_OPTS="-F"

# Packages
BR2_PACKAGE_ANDROID_TOOLS=y
BR2_PACKAGE_ANDROID_TOOLS_ADBD=y
BR2_PACKAGE_BUSYBOX_SHOW_OTHERS=y
# BR2_PACKAGE_IFUPDOWN_SCRIPTS is not set
BR2_PACKAGE_DHCP=y
BR2_PACKAGE_DHCP_SERVER=y
BR2_PACKAGE_LIBV4L=y
BR2_PACKAGE_LIBV4L_UTILS=y
BR2_PACKAGE_OPENCV4=y
BR2_PACKAGE_OPENCV4_LIB_FEATURES2D=y
BR2_PACKAGE_OPENCV4_LIB_HIGHGUI=y
BR2_PACKAGE_OPENCV4_WITH_RK=y
BR2_PACKAGE_UBOOT_TOOLS=y
BR2_PACKAGE_UBOOT_TOOLS_FWPRINTENV=y
```

## configs/luckfox_pico_mini_defconfig
```kconfig
# Architecture
BR2_arm=y
BR2_cortex_a7=y

# Toolchain
BR2_TOOLCHAIN_EXTERNAL=y
BR2_TOOLCHAIN_EXTERNAL_ROCKCHIP_ARM=y

# System configuration
BR2_OPTIMIZE_3=y
BR2_TARGET_GENERIC_HOSTNAME="luckfox-pico"
BR2_TARGET_GENERIC_ISSUE="Welcome to Luckfox Pico"

# Kernel
BR2_LINUX_KERNEL=y
BR2_LINUX_KERNEL_CUSTOM_GIT=y
BR2_LINUX_KERNEL_CUSTOM_REPO_URL="https://github.com/ologn-tech/linux-rv1106.git"
BR2_LINUX_KERNEL_CUSTOM_REPO_VERSION="24ab4f26ef4270d678595aee738f15a21c7338d3"
BR2_LINUX_KERNEL_DTS_SUPPORT=y
BR2_LINUX_KERNEL_CUSTOM_CONFIG_FILE="board/luckfox-pico/common/linux.config"
BR2_LINUX_KERNEL_CUSTOM_DTS_PATH="board/luckfox-pico/mini/rv1103g-luckfox-pico-mini.dts board/luckfox-pico/mini/rv1103-luckfox-pico-ipc.dtsi"
BR2_LINUX_KERNEL_IMAGE_NAME="boot.img"
BR2_LINUX_KERNEL_IMAGE_TARGET_CUSTOM=y
BR2_LINUX_KERNEL_IMAGE_TARGET_NAME="zImage"
BR2_LINUX_KERNEL_USE_CUSTOM_CONFIG=y

# Bootloader
BR2_PACKAGE_HOST_UBOOT_TOOLS=y
BR2_PACKAGE_HOST_UBOOT_TOOLS_ENVIMAGE=y
BR2_PACKAGE_HOST_UBOOT_TOOLS_ENVIMAGE_SOURCE="board/luckfox-pico/common/uboot-env.txt"
BR2_PACKAGE_HOST_UBOOT_TOOLS_ENVIMAGE_SIZE="0x40000"
BR2_PACKAGE_HOST_UBOOT_TOOLS_FIT_SUPPORT=y
BR2_PACKAGE_HOST_UBOOT_TOOLS_FIT_SIGNATURE_SUPPORT=y
BR2_PACKAGE_ROCKCHIP_RKBIN=y
BR2_TARGET_UBOOT=y
BR2_TARGET_UBOOT_BOARD_DEFCONFIG="rv1106"
BR2_TARGET_UBOOT_BUILD_SYSTEM_KCONFIG=y
BR2_TARGET_UBOOT_CUSTOM_GIT=y
BR2_TARGET_UBOOT_CUSTOM_REPO_URL="https://github.com/ologn-tech/u-boot-rv1106.git"
BR2_TARGET_UBOOT_CUSTOM_REPO_VERSION="ea3a627f8771ad9b265a1a6afef561e226c4d33b"
# BR2_TARGET_UBOOT_FORMAT_BIN is not set
BR2_TARGET_UBOOT_FORMAT_CUSTOM=y
BR2_TARGET_UBOOT_FORMAT_CUSTOM_NAME="uboot.img"

# Filesystem
BR2_ROOTFS_POST_BUILD_SCRIPT="board/luckfox-pico/common/post-build.sh"
BR2_ROOTFS_POST_IMAGE_SCRIPT="board/luckfox-pico/common/post-image.sh"
# BR2_TARGET_ROOTFS_TAR is not set
BR2_TARGET_ROOTFS_UBI=y
BR2_TARGET_ROOTFS_UBI_SUBSIZE=0
BR2_TARGET_ROOTFS_UBIFS_LEBSIZE=0x1f000
BR2_TARGET_ROOTFS_UBIFS_MAXLEBCNT=2047
BR2_TARGET_ROOTFS_UBIFS_OPTS="-F"

# Packages
BR2_PACKAGE_ANDROID_TOOLS=y
BR2_PACKAGE_ANDROID_TOOLS_ADBD=y
BR2_PACKAGE_BUSYBOX_SHOW_OTHERS=y
# BR2_PACKAGE_IFUPDOWN_SCRIPTS is not set
BR2_PACKAGE_DHCP=y
BR2_PACKAGE_DHCP_SERVER=y
BR2_PACKAGE_OPENCV4=y
BR2_PACKAGE_OPENCV4_LIB_FEATURES2D=y
BR2_PACKAGE_OPENCV4_LIB_HIGHGUI=y
BR2_PACKAGE_OPENCV4_WITH_RK=y
BR2_PACKAGE_UBOOT_TOOLS=y
BR2_PACKAGE_UBOOT_TOOLS_FWPRINTENV=y
```

## configs/luckfox_pico_ultra_defconfig
```kconfig
# Architecture
BR2_arm=y
BR2_cortex_a7=y

# Toolchain
BR2_TOOLCHAIN_EXTERNAL=y
BR2_TOOLCHAIN_EXTERNAL_ROCKCHIP_ARM=y

# System configuration
BR2_OPTIMIZE_3=y
BR2_TARGET_GENERIC_HOSTNAME="luckfox-pico"
BR2_TARGET_GENERIC_ISSUE="Welcome to Luckfox Pico"

# Kernel
BR2_LINUX_KERNEL=y
BR2_LINUX_KERNEL_CONFIG_FRAGMENT_FILES="board/luckfox-pico/ultra/rv1106-bt.config"
BR2_LINUX_KERNEL_CUSTOM_CONFIG_FILE="board/luckfox-pico/common/linux.config"
BR2_LINUX_KERNEL_CUSTOM_DTS_PATH="board/luckfox-pico/ultra/rv1106g-luckfox-pico-ultra-w.dts board/luckfox-pico/ultra/rv1106-luckfox-pico-ultra-ipc.dtsi"
BR2_LINUX_KERNEL_CUSTOM_GIT=y
BR2_LINUX_KERNEL_CUSTOM_REPO_URL="https://github.com/ologn-tech/linux-rv1106.git"
BR2_LINUX_KERNEL_CUSTOM_REPO_VERSION="a26b7a6f33d611754a2501bdbc43a1af6af129f2"
BR2_LINUX_KERNEL_DTS_SUPPORT=y
BR2_LINUX_KERNEL_IMAGE_NAME="boot.img"
BR2_LINUX_KERNEL_IMAGE_TARGET_CUSTOM=y
BR2_LINUX_KERNEL_IMAGE_TARGET_NAME="zImage"
BR2_LINUX_KERNEL_USE_CUSTOM_CONFIG=y

# Bootloader
BR2_PACKAGE_HOST_UBOOT_TOOLS=y
BR2_PACKAGE_HOST_UBOOT_TOOLS_ENVIMAGE=y
BR2_PACKAGE_HOST_UBOOT_TOOLS_ENVIMAGE_SOURCE="board/luckfox-pico/ultra/uboot-env.txt"
BR2_PACKAGE_HOST_UBOOT_TOOLS_ENVIMAGE_SIZE="0x40000"
BR2_PACKAGE_HOST_UBOOT_TOOLS_FIT_SUPPORT=y
BR2_PACKAGE_HOST_UBOOT_TOOLS_FIT_SIGNATURE_SUPPORT=y
BR2_PACKAGE_ROCKCHIP_RKBIN=y
BR2_TARGET_UBOOT=y
BR2_TARGET_UBOOT_BOARD_DEFCONFIG="rv1106-emmc-tb"
BR2_TARGET_UBOOT_BUILD_SYSTEM_KCONFIG=y
BR2_TARGET_UBOOT_CONFIG_FRAGMENT_FILES="board/luckfox-pico/ultra/rk-emmc.config"
BR2_TARGET_UBOOT_CUSTOM_GIT=y
BR2_TARGET_UBOOT_CUSTOM_REPO_URL="https://github.com/rockchip-linux/u-boot.git"
BR2_TARGET_UBOOT_CUSTOM_REPO_VERSION="2687dce2617032930f2c43fef349bdea694c6f68"
# BR2_TARGET_UBOOT_FORMAT_BIN is not set
BR2_TARGET_UBOOT_FORMAT_CUSTOM=y
BR2_TARGET_UBOOT_FORMAT_CUSTOM_NAME="uboot.img"

# Filesystem
BR2_ROOTFS_POST_BUILD_SCRIPT="board/luckfox-pico/common/post-build.sh"
BR2_ROOTFS_POST_IMAGE_SCRIPT="board/luckfox-pico/ultra/post-image.sh"
BR2_TARGET_ROOTFS_TAR=y
BR2_TARGET_ROOTFS_TAR_NONE=y
BR2_TARGET_ROOTFS_TAR_OPTIONS=""

# Packages
BR2_PACKAGE_ANDROID_TOOLS=y
BR2_PACKAGE_ANDROID_TOOLS_ADBD=y
BR2_PACKAGE_BUSYBOX_SHOW_OTHERS=y
BR2_PACKAGE_DHCP=y
BR2_PACKAGE_DHCP_SERVER=y
# BR2_PACKAGE_IFUPDOWN_SCRIPTS is not set
BR2_PACKAGE_LIBV4L=y
BR2_PACKAGE_LIBV4L_UTILS=y
BR2_PACKAGE_OPENCV4=y
BR2_PACKAGE_OPENCV4_LIB_FEATURES2D=y
BR2_PACKAGE_OPENCV4_LIB_HIGHGUI=y
BR2_PACKAGE_OPENCV4_LIB_PHOTO=y
BR2_PACKAGE_OPENCV4_LIB_PYTHON=y
BR2_PACKAGE_OPENCV4_LIB_VIDEO=y
BR2_PACKAGE_OPENCV4_WITH_RK=y
BR2_PACKAGE_PYTHON3=y
BR2_PACKAGE_PYTHON_PILLOW=y
BR2_PACKAGE_UBOOT_TOOLS=y
BR2_PACKAGE_UBOOT_TOOLS_FWPRINTENV=y
```

## package/luckfox-pico-rtsp-opencv-capture/Config.in
```kconfig
config BR2_PACKAGE_LUCKFOX_PICO_RTSP_OPENCV_CAPTURE
	bool "luckfox-pico-rtsp-opencv-capture"
	depends on BR2_PACKAGE_OPENCV4
	depends on BR2_PACKAGE_OPENCV4_LIB_HIGHGUI
	depends on BR2_PACKAGE_OPENCV4_WITH_RK
	help
	  Build RTSP OpenCV capture example for Luckfox Pico.

comment "luckfox-pico-rtsp-opencv-capture needs OpenCV4 with RK support and specific libraries"
	depends on !BR2_PACKAGE_OPENCV4 || !BR2_PACKAGE_OPENCV4_LIB_HIGHGUI || !BR2_PACKAGE_OPENCV4_WITH_RK
```

## package/luckfox-pico/Config.in
```kconfig
config BR2_PACKAGE_LUCKFOX_PICO
	bool "luckfox-pico"
	help
	  luckfox-pico sdk

	  https://github.com/LuckfoxTECH/luckfox-pico
```

## package/rv1106-ipc-sdk/Config.in
```kconfig
config BR2_PACKAGE_RV1106_IPC_SDK
	bool "rv1106-ipc-sdk"
	help
	  RV1106 IPC SDK.
```

## toolchain/toolchain-external/toolchain-external-rockchip-arm/Config.in
```kconfig
config BR2_TOOLCHAIN_EXTERNAL_ROCKCHIP_ARM
	bool "Rockchip ARM"
	depends on BR2_arm
	depends on BR2_HOSTARCH = "x86_64"
	select BR2_PACKAGE_LUCKFOX_PICO
	select BR2_INSTALL_LIBSTDCPP
	select BR2_TOOLCHAIN_EXTERNAL_UCLIBC
	select BR2_TOOLCHAIN_GCC_AT_LEAST_8
	select BR2_TOOLCHAIN_HAS_SSP
	select BR2_TOOLCHAIN_HAS_THREADS
	select BR2_TOOLCHAIN_HAS_THREADS_DEBUG
	select BR2_TOOLCHAIN_HAS_THREADS_NPTL
	select BR2_TOOLCHAIN_HEADERS_AT_LEAST_5_10
	select BR2_USE_WCHAR
	help
	  Rockchip ARM toolchain from luckfox-pico sdk
```
